// SPDX-License-Identifier: GPL-2.0-or-later OR MIT

#include "ar9331_tplink_tl-wr703n_tl-mr11u.dtsi"

/ {
	model = "TP-Link TL-MR11U";
	compatible = "tplink,tl-mr11u", "qca,ar9331";
};

&reg_usb_vbus {
	gpio = <&gpio 8 GPIO_ACTIVE_HIGH>;
};
